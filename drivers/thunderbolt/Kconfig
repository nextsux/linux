## drivers/thunderbolt/Kconfig
```kconfig
menuconfig THUNDERBOLT
	tristate "Apple Thunderbolt hotplug support"
	default no
	help
	  Cactus Ridge Thunderbolt Controller driver
	  This driver is required if you want to hotplug Thunderbolt devices on
	  Apple hardware.

	  Device chaining is currently not supported.

	  To compile this driver a module, choose M here. The module will be
	  called thunderbolt.
```
